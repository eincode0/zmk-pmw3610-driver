## dts/bindings/pixart,pmw3610-alt.yml
```yaml
description: |
  Sensor driver for the pixart PMW3610 mouse sensor 

compatible: "pixart,pmw3610-alt"

include: spi-device.yaml

properties:
  irq-gpios:
    type: phandle-array
    required: true
  cpi:
    type: int
    default: 600
    description: "CPI value (Range: 200 - 3200, Step: 200)"
  swap-xy:
    type: boolean
  invert-x:
    type: boolean
  invert-y:
    type: boolean
  evt-type:
    type: int
    required: true
  x-input-code:
    type: int
    required: true
  y-input-code:
    type: int
    required: true
  force-awake:
    type: boolean
  force-awake-4ms-mode:
    type: boolean
  scroll-layers:
    type: array
    description: |
      Layer numbers that activate scroll mode.
      Driver emits WHEEL/HWHEEL instead of REL_X/REL_Y.
      Speed controlled by CONFIG_PMW3610_ALT_SCROLL_TICK.
      Example: scroll-layers = <5>;
  snipe-layers:
    type: array
    description: |
      Layer numbers that activate snipe (precision) mode.
      Driver divides cursor movement by CONFIG_PMW3610_ALT_SNIPE_CPI_DIVIDOR,
      with remainder carry-over for lossless precision.
      Example: snipe-layers = <15>;
  cpi-layers:
    type: array
    description: |
      Layer-driven CPI override. Flat array of [layer, cpi] uint16 pairs.
      Highest active matching layer's CPI is applied; falls back to base cpi
      when none active. Example: cpi-layers = <4 3200>;
  arrows-profiles:
    type: array
    description: |
      レイヤーごとのキーマッピング。
      9個ずつのセットで記述:
      [layer, key_up, key_down, key_left, key_right, tick, use_remainder, no_diagonal, one_shot]
      複数レイヤーを並べて書ける。

      one_shot=1 のとき、方向ごとに1回発火したら次の方向変化まで無視する。

      Linux keycode早見表:
        矢印キー  UP=103 DOWN=108 LEFT=105 RIGHT=106
        PageUp/Down    104 / 109
        Home / End     102 / 107
        Enter          28
        Tab            15
        Escape         1
        LANG2 (英数)   58
        LANG1 (かな)   90

      例:
        arrows-profiles = <
            3   103 108 105 106  40  0  1  0  /* layer 3: 矢印キー */
            4   104 109 102 107  40  0  1  0  /* layer 4: PageUp/Down Home/End */
        >;
  numpad-layers:
    type: array
    description: |
      Layer numbers that activate numpad 2-stroke input mode.
      Example: numpad-layers = <2>;
  numpad-tick:
    type: int
    default: 15
    description: |
      Stroke detection threshold (raw delta). Default 15.
      小さいほど敏感、大きいほど大きく動かさないと反応しない。
  numpad-timeout-ms:
    type: int
    default: 1000
    description: |
      2ストローク目の入力待ちタイムアウト(ms)。
      この時間内に2ストローク目が来なければリセット。Default 1000ms。

  arrows-no-repeat-layers:
    type: array
    description: |
      Layers where arrow key auto-repeat is disabled (single fire only).
      Example: arrows-no-repeat-layers = <2>;
  arrows-tick:
    type: int
    default: 10
    description: |
      Raw delta threshold to fire one arrow key event. Default 10.
  arrows-diagonal:
    type: boolean
    description: |
      Allow diagonal arrow key output. When enabled, both X and Y axes can
      fire simultaneously. Default off (dominant axis only).
  arrows-accel:
    type: boolean
    description: |
      Enable acceleration: faster trackball movement reduces the effective
      tick, causing more rapid key firing.
  arrows-accel-max-div:
    type: int
    default: 4
    description: |
      Maximum divisor applied to tick at high speed. Default 4 (tick/4 at peak).
  arrows-accel-threshold:
    type: int
    default: 20
    description: |
      Raw delta magnitude at which max acceleration is reached. Default 20.
  arrows-repeat-delay-ms:
    type: int
    default: 300
    description: |
      Delay before auto-repeat starts when holding a direction (ms).
      Set to 0 to disable auto-repeat. Default 300.
  arrows-repeat-rate-ms:
    type: int
    default: 50
    description: |
      Interval between auto-repeat key events (ms). Default 50.
  scroll-inertia:
    type: boolean
    description: Enable inertia (momentum) scrolling.
  scroll-inertia-decay:
    type: int
    default: 75
    description: |
      Decay % applied when speed is slow (scroll-inertia-slow-spd or below).
      Lower = stops faster. Default: 75.
  scroll-inertia-decay-fast:
    type: int
    default: 92
    description: |
      Decay % applied when speed is fast (scroll-inertia-fast-spd or above).
      Higher = longer glide on fast flicks. Default: 92.
  scroll-inertia-slow-spd:
    type: int
    default: 2
    description: |
      Speed (scroll units/tick) at or below which slow decay applies. Default: 2.
  scroll-inertia-fast-spd:
    type: int
    default: 6
    description: |
      Speed (scroll units/tick) at or above which fast decay applies. Default: 6.
  scroll-inertia-tick-ms:
    type: int
    default: 16
    description: |
      Timer interval for inertia decay in ms. Default 16ms (~60fps).
  scroll-flick-threshold:
    type: int
    default: 6
    description: |
      4-sample average raw delta needed to trigger flick detection.
      Lower = more sensitive. Default: 6.
  scroll-flick-boost:
    type: int
    default: 512
    description: |
      Velocity multiplier applied on flick, in fixed-point *256.
      512 = 2x boost, 384 = 1.5x, 256 = no boost. Default: 512.
  scroll-accel:
    type: boolean
    description: |
      Enable scroll acceleration: amplify scroll delta based on ball speed.
      Slow movement = 1x, fast movement = scroll-accel-max-mult x.
  scroll-accel-max-mult:
    type: int
    default: 4
    description: |
      Maximum scroll multiplier at high speed. Default 4 (4x at threshold).
  scroll-accel-threshold:
    type: int
    default: 20
    description: |
      Raw delta speed at which maximum multiplier is reached. Default 20.
      小さいほど少ない動きで最大倍率に達する。
  pointer-inertia:
    type: boolean
    description: Enable pointer (cursor) inertia/momentum on strong flick.
  pointer-inertia-decay:
    type: int
    default: 80
    description: Decay % at slow speed. Lower = stops faster. Default 80.
  pointer-inertia-decay-fast:
    type: int
    default: 97
    description: Decay % at fast speed. Higher = longer glide. Default 97.
  pointer-inertia-slow-spd:
    type: int
    default: 5
    description: Speed threshold for slow decay. Default 5.
  pointer-inertia-fast-spd:
    type: int
    default: 30
    description: Speed threshold for fast decay. Default 30.
  pointer-inertia-tick-ms:
    type: int
    default: 16
    description: Timer interval ms. Default 16.
  pointer-flick-threshold:
    type: int
    default: 8
    description: 4-sample avg delta to trigger flick. 0=always. Default 8.
  pointer-flick-boost:
    type: int
    default: 512
    description: Velocity multiplier *256 on flick. 512=2x. Default 512.
  arrows-alt-profiles:
    type: array
    description: |
      arrows_alt_mode が ON のときだけ有効なレイヤープロファイル。
      9要素×Nプロファイル（arrows-profiles と同形式）:
      [layer, key_up, key_down, key_left, key_right, tick_override, use_remainder, no_diagonal, one_shot]
      zmk_keymap_layer_active() で判定するため最高レイヤーでなくても一致する。
      例: MOUSE レイヤー（4）で &arrows_alt 3 を保持中にレイヤー3のプロファイルを使う。
  no-sample-accumulation:
    type: boolean
    description: |
      2サンプル蓄積を無効化し、センサーのサンプルごとに HID レポートを送出する。
      蓄積処理は POLLING_RATE_250 (Kconfig 既定) を 125Hz レポートへ落とすために
      書かれたもので、POLLING_RATE_125 と併用すると 62.5Hz (16ms) まで二重に半減し、
      60Hz ディスプレイ (16.67ms) とのうなりでカーソルが周期的に凍る。
      本プロパティを立てるとセンサーのポーリングレート・消費電流は据え置きのまま、
      レポート周期だけが 1/2 (125Hz 運用で 8ms) に戻る。増えるのは HID 通知頻度のみ。
      注意: 1レポートあたりの delta が半減するため、iir-filter-alpha の切り捨て損失が
      相対的に大きくなる。本プロパティと併せて alpha を 1024 (無効) 付近に上げること。
      未指定時は従来通り蓄積する (後方互換)。
  iir-filter-alpha:
    type: int
    default: 614
    description: |
      IIR フィルタの固定小数点係数（α = coefficient / 1024）。
      614 = 0.6, 512 = 0.5. モーションノイズ低減用。
      値が大きいほど現在値の影響が強くなり、応答性が上がる一方、ノイズが残りやすくなる。
      Default: 614 (α=0.6, 低レイテンシ向け)
  speed-based-cpi:
    type: boolean
    description: |
      Enable speed-based CPI dynamic adjustment.
      Raw delta speed に基づいて 3段階の CPI を自動切り替える。
  speed-cpi-low-threshold:
    type: int
    default: 5
    description: |
      Low speed threshold (raw delta/sample). Below this: speed-cpi-low.
      Default: 5 (精密操作向け)
  speed-cpi-high-threshold:
    type: int
    default: 30
    description: |
      High speed threshold (raw delta/sample). Above this: speed-cpi-high.
      Default: 30 (高速移動向け)
  speed-cpi-low:
    type: int
    default: 1200
    description: |
      CPI value for low speed (≤ speed-cpi-low-threshold).
      Default: 1200 (精密モード)
  speed-cpi-medium:
    type: int
    default: 2200
    description: |
      CPI value for medium speed (between low and high thresholds).
      Default: 2200 (通常モード)
  speed-cpi-high:
    type: int
    default: 3200
    description: |
      CPI value for high speed (≥ speed-cpi-high-threshold).
      Default: 3200 (高速モード)
```
